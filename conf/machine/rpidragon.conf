## conf/machine/rpidragon.conf
```bitbake
require conf/machine/raspberrypi3-64.conf

MACHINEOVERRIDES =. "raspberrypi3:raspberrypi3-64:"

KERNEL_MODULE_AUTOLOAD += "brcmfmac"

# IMHO this should be in raspberrypi3.conf
MACHINE_FEATURES += "vc4graphics"

# Remove black border
DISABLE_OVERSCAN = "1"

# Heavily recommended for Wayland/Weston.
DISPMANX_OFFLINE = "1"

GPU_MEM = "128"

ENABLE_UART = "1"
INSTALL_append = "rpi-config"

KERNEL_MODULE_AUTOLOAD += "brcmfmac"
```
